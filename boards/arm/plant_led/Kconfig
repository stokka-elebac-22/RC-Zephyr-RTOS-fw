## boards/arm/plant_led/Kconfig
```kconfig
# Copyright (c) 2018 Nordic Semiconductor ASA
# SPDX-License-Identifier: Apache-2.0

config BOARD_ENABLE_DCDC
	bool "Enable DCDC mode"
	select SOC_DCDC_NRF52X
	default n
```

## drivers/as7341/Kconfig
```kconfig
# Copyright (c) 2019 Nordic Semiconductor
# SPDX-License-Identifier: Apache-2.0

config AS7341
	bool "AS7341 11 Channel Spectral Color sensor"
	depends on I2C
	help
	  Enable driver for the AS7341 11 Channel Spectral Color sensor.
```

## drivers/cap_sensor/Kconfig
```kconfig
# Copyright (c) 2019 Nordic Semiconductor
# SPDX-License-Identifier: Apache-2.0

config CAP_SENSOR
	bool "Capasitive sensing driver Driver"
	depends on PWM
	depends on ADC
	help
	  Cap sensing Driver.
```

## drivers/led_slowpwm/Kconfig
```kconfig
# Copyright (c) 2019 Nordic Semiconductor
# SPDX-License-Identifier: Apache-2.0

config LED_SLOWPWM
	bool "Slow PWM Led Driver"
	depends on PWM
	help
	  2kHz PWM Led Driver.
```

## drivers/pca9632/Kconfig
```kconfig
# Copyright (c) 2019 Nordic Semiconductor
# SPDX-License-Identifier: Apache-2.0

config PCA9632
	bool "PCA9632 Led Driver"
	depends on I2C
	help
	  PCA9632 Led Driver.
```

## tests/testcase.yaml
```yaml
---
tests:
  # section.subsection
  testing.ztest:
    build_only: false
    platform_allow: native_posix
    tags: testing
  build.particle:
    build_only: true
    platform_allow: particle_xenon
    tags: build
  build.soilsensor:
    build_only: true
    platform_allow: soilsensor
    tags: build
  build.plant_led:
    build_only: true
    platform_allow: plant_led
    tags: build
```
